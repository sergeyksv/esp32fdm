## main/Kconfig.projbuild
```kconfig
menu "ESP32 FDM Bridge Configuration"

    config WIFI_SSID
        string "WiFi SSID"
        default "myssid"
        help
            WiFi network name to connect to.

    config WIFI_PASSWORD
        string "WiFi Password"
        default "mypassword"
        help
            WiFi network password.

    config PRINTER_BAUD_RATE
        int "Default Printer Baud Rate"
        default 115200
        help
            Default baud rate for USB serial connection to the printer.

    menu "Obico Integration"

        config OBICO_SERVER_URL
            string "Obico Server URL"
            default "https://app.obico.io"
            help
                Obico server URL. Change for self-hosted instances.

        config OBICO_SNAP_INTERVAL_PRINTING
            int "Snapshot interval during printing (seconds)"
            default 10
            range 5 300
            help
                How often to upload JPEG snapshots while printing or when AI watching.

        config OBICO_SNAP_INTERVAL_IDLE
            int "Snapshot interval when idle (seconds)"
            default 120
            range 30 600
            help
                How often to upload JPEG snapshots when idle.

        config OBICO_STATUS_INTERVAL
            int "WebSocket status interval (seconds)"
            default 30
            range 10 120
            help
                How often to send printer status over WebSocket.

        config OBICO_JANUS_PROXY_HOST
            string "Janus proxy sidecar IP (empty = disabled)"
            default ""
            help
                IP address of the Linux sidecar running janus_proxy.
                Leave empty to disable WebRTC streaming relay.

        config OBICO_JANUS_PROXY_PORT
            int "Janus proxy sidecar port"
            default 17800
            range 1024 65535
            help
                TCP port for the Janus signaling relay connection to sidecar.

    endmenu

    menu "RFC 2217"

        config RFC2217_PORT
            int "RFC 2217 TCP Port"
            default 2217
            range 1 65535
            help
                TCP port for the RFC 2217 serial bridge server.

    endmenu

endmenu
```

## sdkconfig.defaults
```kconfig
# Target
CONFIG_IDF_TARGET="esp32s3"

# PSRAM (OPI 80MHz)
CONFIG_SPIRAM=y
CONFIG_SPIRAM_MODE_OCT=y
CONFIG_SPIRAM_SPEED_80M=y

# Flash (8MB)
CONFIG_ESPTOOLPY_FLASHSIZE_8MB=y
CONFIG_PARTITION_TABLE_CUSTOM=y
CONFIG_PARTITION_TABLE_CUSTOM_FILENAME="partitions.csv"

# FreeRTOS
CONFIG_FREERTOS_HZ=1000
CONFIG_FREERTOS_GENERATE_RUN_TIME_STATS=y
CONFIG_FREERTOS_RUN_TIME_STATS_USING_ESP_TIMER=y

# LWIP — larger TCP window to avoid zero-window stalls during uploads
CONFIG_LWIP_MAX_SOCKETS=16
CONFIG_LWIP_SO_RCVBUF=y
CONFIG_LWIP_TCP_WND_DEFAULT=32768
CONFIG_LWIP_TCP_RECVMBOX_SIZE=64
CONFIG_SPIRAM_TRY_ALLOCATE_WIFI_LWIP=y

# USB Host
CONFIG_USB_OTG_SUPPORTED=y
CONFIG_USB_HOST_CONTROL_TRANSFER_MAX_SIZE=1024

# Camera
CONFIG_CAMERA_TASK_PINNED_TO_CORE_0=y
CONFIG_CAMERA_PSRAM_DMA=y

# WiFi credentials
CONFIG_WIFI_SSID="pushok"
CONFIG_WIFI_PASSWORD="pushok0623"
CONFIG_ESP_WIFI_STATIC_RX_BUFFER_NUM=10
CONFIG_ESP_WIFI_DYNAMIC_RX_BUFFER_NUM=32

# Task watchdog — increase for USB host tasks
CONFIG_ESP_TASK_WDT_TIMEOUT_S=10

# C++ exceptions (required by usb_host_vcp component)
CONFIG_COMPILER_CXX_EXCEPTIONS=y

# Compiler optimization
CONFIG_COMPILER_OPTIMIZATION_PERF=y

# Certificate bundle for TLS to Obico cloud
CONFIG_MBEDTLS_CERTIFICATE_BUNDLE=y
CONFIG_MBEDTLS_CERTIFICATE_BUNDLE_DEFAULT_FULL=y

# PSRAM memory optimization
CONFIG_SPIRAM_MALLOC_ALWAYSINTERNAL=1024
CONFIG_SPIRAM_MALLOC_RESERVE_INTERNAL=16384

# SNTP for timestamps
CONFIG_LWIP_SNTP_MAX_SERVERS=2

# HTTP server — browsers send large headers (cookies, Referer, Origin)
CONFIG_HTTPD_MAX_REQ_HDR_LEN=1024
CONFIG_HTTPD_MAX_URI_LEN=1024

# FAT filesystem — long filename support for SD card
CONFIG_FATFS_LFN_HEAP=y
CONFIG_FATFS_MAX_LFN=127
```
